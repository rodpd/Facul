#INCLUDE <P16F628A.INC>		;ARQUIVO PADRÃO MICROCHIP PARA 16F628A
__CONFIG H'3F10'

	CBLOCK	0x20	;ENDEREÇO INICIAL DA MEMÓRIA DE USUÁRIO
	CONTADOR1	
	ENDC			;FIM DO BLOCO DE MEMÓRIA		

#DEFINE	BOTAO	PORTA,2	;PORTA DO BOTÃO
					; 0 -> PRESSIONADO
					; 1 -> LIBERADO

#DEFINE	LED	PORTB,0	;PORTA DO LED
				; 0 -> APAGADO
				; 1 -> ACESO
	ORG	0x00		;ENDEREÇO INICIAL DE PROCESSAMENTO
	GOTO	INICIO
	
INICIO
	CLRF	PORTA		;LIMPA O PORTA
	CLRF	PORTB		;LIMPA O PORTB
	BSF STATUS, RP0			;ALTERA PARA O BANCO 1
	MOVLW	B'00000100'
	MOVWF	TRISA		;DEFINE RA2 COMO ENTRADA E DEMAIS COMO SAÍDAS
	CLRF	TRISB		;DEFINE TODO O PORTB COMO SAÍDA
	CLRF	INTCON		;TODAS AS INTERRUPÇÕES DESLIGADAS
	BCF STATUS, RP0 ;RETORNA PARA O BANCO 0
	MOVLW	B'00000111'
	MOVWF	CMCON

MAIN

	BTFSC	BOTAO		;O BOTÃO ESTÁ PRESSIONADO?
	GOTO	MAIN 		;NÃO, ENTÃO ESPERA PRESSIONAR
	GOTO	BOTAO_PRES1	;SIM, ENTÃO TRATA BOTÃO PRESSIONADO


BOTAO_PRES1
	BTFSS	BOTAO		;O BOTÃO AINDA ESTÁ PRESSIONADO?
	GOTO	BOTAO_PRES1	;SIM, ENTÃO ESPERA DESLIGAR
	BSF	LED		;NÃO, ACENDE O LED
	GOTO 	TESTA1		;RETORNA AO LOOP PRINCIPAL

TESTA1
	BTFSC	BOTAO		;O BOTÃO ESTÁ PRESSIONADO?
	GOTO	TESTA1		;NÃO, ENTÃO ESPERA PRESSIONAR
	GOTO	BOTAO_PRES2	;SIM, ENTÃO TRATA BOTÃO PRESSIONADO


BOTAO_PRES2
	BTFSS	BOTAO		;O BOTÃO AINDA ESTÁ PRESSIONADO?
	GOTO	BOTAO_PRES2	;SIM, ENTÃO ESPERA DESLIGAR
	BCF	LED		;NÃO, ACENDE O LED
	GOTO 	MAIN		;RETORNA AO LOOP PRINCIPAL

	END			;OBRIGATÓRIO



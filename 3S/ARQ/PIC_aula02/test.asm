RADIX DEC
#INCLUDE <P16F628A.INC>		;ARQUIVO PADRÃO MICROCHIP PARA 16F628A
__CONFIG H'3F10'

	CBLOCK	0x20	;ENDEREÇO INICIAL DA MEMÓRIA DE USUÁRIO
	CONTADOR1
	CONTADOR2
	CONTADOR3
	ENDC			;FIM DO BLOCO DE MEMÓRIA		

#DEFINE	BOTAO	PORTA,2	;PORTA DO BOTÃO
					; 0 -> PRESSIONADO
					; 1 -> LIBERADO

#DEFINE	LED0	PORTB,0	;PORTA DO LED
				; 0 -> APAGADO
				; 1 -> ACESO

#DEFINE	LED1	PORTB,1	;PORTA DO LED
				; 0 -> APAGADO
				; 1 -> ACESO

#DEFINE	LED2	PORTB,2	;PORTA DO LED
				; 0 -> APAGADO
				; 1 -> ACESO

#DEFINE	LED3	PORTB,3	;PORTA DO LED
				; 0 -> APAGADO
				; 1 -> ACESO

#DEFINE	LED4	PORTB,4	;PORTA DO LED
				; 0 -> APAGADO
				; 1 -> ACESO

#DEFINE	LED5	PORTB,5	;PORTA DO LED
				; 0 -> APAGADO
				; 1 -> ACESO


	ORG	0x00		;ENDEREÇO INICIAL DE PROCESSAMENTO
	GOTO	INICIO
	
INICIO
	CLRF	PORTA		;LIMPA O PORTA
	CLRF	PORTB		;LIMPA O PORTB
	BSF STATUS, RP0			;ALTERA PARA O BANCO 1
	MOVLW	B'00000100'
	MOVWF	TRISA		;DEFINE RA2 COMO ENTRADA E DEMAIS COMO SAÍDAS
	CLRF	TRISB		;DEFINE TODO O PORTB COMO SAÍDA
	CLRF	INTCON		;TODAS AS INTERRUPÇÕES DESLIGADAS
	BCF STATUS, RP0 ;RETORNA PARA O BANCO 0
	MOVLW	B'00000111'
	MOVWF	CMCON

REPETE

	BSF LED0
	CALL ATRASO
	CALL ATRASO
	BCF LED0
	BSF LED1
	CALL ATRASO
	CALL ATRASO
	CALL ATRASO
	CALL ATRASO
	BCF LED1
	BSF LED2
	CALL ATRASO
	CALL ATRASO
	CALL ATRASO
	CALL ATRASO
	CALL ATRASO
	CALL ATRASO
	BCF LED2
	BSF LED3
	CALL ATRASO
	CALL ATRASO
	CALL ATRASO
	CALL ATRASO
	CALL ATRASO
	CALL ATRASO
	CALL ATRASO
	CALL ATRASO
	BCF LED3
	BSF LED4
	CALL ATRASO
	CALL ATRASO
	CALL ATRASO
	CALL ATRASO
	CALL ATRASO
	CALL ATRASO
	CALL ATRASO
	CALL ATRASO
	CALL ATRASO
	CALL ATRASO
	BCF LED4
	GOTO REPETE
	BTFSC	BOTAO		;O BOTÃO ESTÁ PRESSIONADO?
	;GOTO	MAIN            ; NAO, ESPERA SER PRESSIONADO
	;GOTO	BOTAO_PRES1	;SIM, ENTÃO TRATA BOTÃO PRESSIONADO


ATRASO
	MOVLW	220
	MOVWF	CONTADOR3	;INICIA CONTADOR3


ATRASO3					
	MOVLW	131
	MOVWF	CONTADOR2	;INICIA CONTADOR2
	DECFSZ	CONTADOR3	;REDUZ CONTADOR3
	GOTO	ATRASO2		;CHAMA ATRASO2 SE NAO FOR 0
	BSF 	LED5
	BCF		LED5

	RETURN				;SE FOR IGUAL A 0, RETORNA


ATRASO2
	MOVLW	8
	MOVWF	CONTADOR1	;INICIA CONTADOR1
	BTFSC	BOTAO
	GOTO	BOTAOPRESSIONADO
	DECFSZ  CONTADOR2	;REDUZ CONTADOR2
	GOTO	ATRASO1		;CHAMA ATRASO1 SE NAO FOR 0
	GOTO	ATRASO3		;SE FOR IGUAL A 0, VOLTA PARA ATRASO3


ATRASO1
	DECFSZ	CONTADOR1	;REDUZ CONTADOR ATE SER IGUAL A 0
	GOTO	ATRASO1
	GOTO 	ATRASO2		;DEPOIS VOLTA PARA ATRASO2	


BOTAOPRESSIONADO
	BTFSC	LED4
	GOTO	BOTAO4
	BTFSC	LED3
	GOTO	BOTAO3
	BTFSC	LED2
	GOTO	BOTAO2
	BTFSC	LED1
	GOTO 	BOTAO1
	GOTO	BOTAO0


BOTAO4
	CALL ATRASOBOTAO
	BCF LED4
	BSF LED3
	GOTO BOTAO3
	
	
BOTAO3
	CALL ATRASOBOTAO
	BCF LED3
	BSF LED2
	GOTO BOTAO2
	
	
BOTAO2
	CALL ATRASOBOTAO
	BCF LED2
	BSF LED1
	GOTO BOTAO1
	
	
BOTAO1
	CALL ATRASOBOTAO
	BCF	LED1
	BSF	LED0
	GOTO BOTAO0
	

BOTAO0
	CALL ATRASOBOTAO
	CALL ATRASOBOTAO
	CALL ATRASOBOTAO
	CALL ATRASOBOTAO
	CALL ATRASOBOTAO
	GOTO REPETE
	

ATRASOBOTAO
	MOVLW	B'00000011'
	MOVWF	CONTADOR3	;INICIA CONTADOR3


ATRASOBOTAO3				
	MOVLW	B'00000011'
	MOVWF	CONTADOR2	;INICIA CONTADOR2
	DECFSZ	CONTADOR3	;REDUZ CONTADOR3
	GOTO	ATRASOBOTAO2		;CHAMA ATRASO2 SE NAO FOR 0
	BSF 	LED5
	BCF		LED5
	RETURN				;SE FOR IGUAL A 0, RETORNA


ATRASOBOTAO2
	MOVLW	B'00001000'
	MOVWF	CONTADOR1	;INICIA CONTADOR1
	DECFSZ  CONTADOR2	;REDUZ CONTADOR2
	GOTO	ATRASOBOTAO1		;CHAMA ATRASO1 SE NAO FOR 0
	GOTO	ATRASOBOTAO3		;SE FOR IGUAL A 0, VOLTA PARA ATRASO3


ATRASOBOTAO1
	DECFSZ	CONTADOR1	;REDUZ CONTADOR ATE SER IGUAL A 0
	GOTO	ATRASOBOTAO1
	GOTO 	ATRASOBOTAO2		;DEPOIS VOLTA PARA ATRASO2
	RETURN


	END			;OBRIGATÓRIO

